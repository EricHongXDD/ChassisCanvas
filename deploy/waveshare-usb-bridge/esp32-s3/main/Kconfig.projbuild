## deploy/waveshare-usb-bridge/esp32-s3/main/Kconfig.projbuild
```kconfig
menu "CaseScreen USB 小桥（实验）"

    config CASESCREEN_RNDIS_FIRST_VERIFIED
        bool "已在实体屏验证 RNDIS-first 描述符"
        default n
        help
            这是一个失败关闭的实验门禁。乐鑫官方 RNDIS Host 驱动要求 RNDIS 是
            复合设备的第一个功能。只有确认微雪 RNDIS 的 bFirstInterface=0，且
            ACM/Windows 串口回归通过后才能启用。

    config CASESCREEN_WIFI_SSID
        string "Wi-Fi STA SSID"
        default ""
        help
            仅用于实验的 Wi-Fi 名称。它会写入 sdkconfig 和固件；此骨架尚未实现
            安全配网。

    config CASESCREEN_WIFI_PASSWORD
        string "Wi-Fi STA 密码"
        default ""
        help
            仅用于实验的 Wi-Fi 密码。只有开放网络才能留空。它会写入 sdkconfig
            和固件。

    config CASESCREEN_WIFI_MAXIMUM_RETRY
        int "Wi-Fi 驱动重试次数"
        range 1 20
        default 5

endmenu
```

## deploy/waveshare-usb-bridge/esp32-s3/sdkconfig.defaults
```kconfig
# ESP-IDF v5.5.x；与乐鑫 USB RNDIS 官方示例采用同一主版本。
CONFIG_ESPTOOLPY_FLASHMODE_QIO=y
CONFIG_ESPTOOLPY_FLASHSIZE_4MB=y

# USB RNDIS 转发只需要 IPv4。NAPT 必须同时打开 IP forwarding。
CONFIG_LWIP_IP_FORWARD=y
CONFIG_LWIP_IPV4_NAPT=y
CONFIG_LWIP_IPV6=n

# 取自乐鑫 usb_rndis_4g_module 示例的控制传输配置。
CONFIG_USB_HOST_CONTROL_TRANSFER_MAX_SIZE=512
CONFIG_USBH_CDC_CONTROL_TRANSFER_BUFFER_SIZE=1025

# 默认不开启实体兼容性确认，固件启动时会失败关闭。
# CONFIG_CASESCREEN_RNDIS_FIRST_VERIFIED is not set
```
